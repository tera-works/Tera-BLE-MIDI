## main/Kconfig.projbuild
```kconfig
menu "Tera BLE MIDI"
config TERA_NAME
    string "BLE device name (max 29 ASCII bytes)"
    default "ESP MIDI"
config TERA_RX_GPIO
    int "Module RX GPIO (main MCU TX)"
    range 0 39
    default 16
config TERA_TX_GPIO
    int "Module TX GPIO (main MCU RX)"
    range 0 33
    default 17
config TERA_DEBUG
    bool "Development status logs on UART0"
    default n
config TERA_LED_ENABLED
    bool "Single LED connection and MIDI activity indication"
    default y
    help
        Optional LED. Disable to keep the original lowest-power four-wire design.
        The low-priority display task observes counters; MIDI never waits for it.
config TERA_LED_GPIO
    int "Status LED GPIO"
    depends on TERA_LED_ENABLED
    range 0 33
    default 25
config TERA_LED_ACTIVE_LOW
    bool "LED lights when GPIO is LOW"
    depends on TERA_LED_ENABLED
    default n
config TERA_PROBE_GPIO
    int "Development latency pulse GPIO (-1 disables)"
    range -1 33
    default -1
endmenu
```

## sdkconfig.defaults
```kconfig
CONFIG_IDF_TARGET="esp32"
CONFIG_FREERTOS_UNICORE=y
CONFIG_FREERTOS_HZ=1000
CONFIG_FREERTOS_USE_TICKLESS_IDLE=y
CONFIG_PM_ENABLE=y
CONFIG_ESP_DEFAULT_CPU_FREQ_MHZ_240=y
CONFIG_COMPILER_OPTIMIZATION_PERF=y
CONFIG_ESPTOOLPY_FLASHMODE_DIO=y
CONFIG_ESPTOOLPY_FLASHFREQ_40M=y
CONFIG_ESPTOOLPY_FLASHSIZE_4MB=y
CONFIG_BT_ENABLED=y
CONFIG_BT_CONTROLLER_ENABLED=y
CONFIG_BTDM_CTRL_MODE_BLE_ONLY=y
CONFIG_BTDM_CTRL_BLE_MAX_CONN=1
CONFIG_BT_BLUEDROID_ENABLED=n
CONFIG_BT_NIMBLE_ENABLED=y
CONFIG_BT_NIMBLE_ROLE_CENTRAL=n
CONFIG_BT_NIMBLE_ROLE_OBSERVER=n
CONFIG_BT_NIMBLE_ROLE_PERIPHERAL=y
CONFIG_BT_NIMBLE_ROLE_BROADCASTER=y
CONFIG_BT_NIMBLE_MAX_CONNECTIONS=1
CONFIG_BT_NIMBLE_PINNED_TO_CORE_0=y
CONFIG_BT_NIMBLE_HOST_TASK_STACK_SIZE=4096
CONFIG_BT_NIMBLE_ATT_PREFERRED_MTU=185
CONFIG_BT_NIMBLE_MSYS_1_BLOCK_COUNT=24
CONFIG_BT_NIMBLE_MSYS_2_BLOCK_COUNT=12
CONFIG_BT_NIMBLE_LOG_LEVEL_NONE=y
CONFIG_BTDM_CTRL_MODEM_SLEEP=y
CONFIG_BTDM_CTRL_MODEM_SLEEP_MODE_ORIG=y
CONFIG_BTDM_CTRL_LPCLK_SEL_MAIN_XTAL=y
CONFIG_LOG_DEFAULT_LEVEL_NONE=y
CONFIG_LOG_MAXIMUM_LEVEL=0
CONFIG_BOOTLOADER_LOG_LEVEL_NONE=y
CONFIG_ESP_CONSOLE_NONE=y
CONFIG_TERA_DEBUG=n
```
